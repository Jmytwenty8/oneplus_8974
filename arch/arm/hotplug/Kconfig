## arch/arm/hotplug/Kconfig
```kconfig
config MAKO_HOTPLUG
        bool "Enable mako_hotplug cpu hotplug driver"
        default n
        help
          Generic mako_hotplug cpu hotplug driver for ARM SOCs

config BLU_PLUG
 	bool "Dynamic hotplug driver"
 	depends on HOTPLUG_CPU
 	default n
 	help
 	  The Dynamic hotplug driver automatically online/offline CPUs proportional to system load.
```
